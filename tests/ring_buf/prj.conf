## prj.conf
```kconfig
# Enable the Ztest unit testing framework
CONFIG_ZTEST=y

# Randomize suite and test order to catch ordering dependencies early
CONFIG_ZTEST_SHUFFLE=y

# to preserve the timeout equal to 60 and shuffle ON, we have to turn off repeat
#CONFIG_ZTEST_REPEAT=n

# Enable logging
CONFIG_LOG=y
```

## src/test_ring_buf.c
```c
/*
 * Ring Buffer Module - Homework Test Skeleton
 *
 * test_fresh_state is provided as a worked example. Fill in the remaining
 * 7 ZTEST bodies according to TEST_SPEC.md. Stubs call ztest_test_skip()
 * so the binary builds and runs cleanly before each test is implemented.
 *
 * Run:
 *   west twister -T tests/ring_buf -p native_sim
 */

#include <zephyr/ztest.h>
#include <errno.h>

#include "ring_buf.h"

/*
 * Shared before hook: every suite reinitialises the ring buffer with a
 * capacity of 4 so tests start from a clean, known state. Capacity 4 is
 * enough to exercise FIFO order (push 1, 2, 3) and overflow (full at 4).
 */
static void before(void *f)
{
	ARG_UNUSED(f);
	rb_init(4);
}

/*
 * ============================================================================
 * Test Suite: ring_buf_init
 *
 * Initial state and re-initialization behaviour.
 * ============================================================================
 */
ZTEST_SUITE(ring_buf_init, NULL, NULL, before, NULL, NULL);

/* PROVIDED — study this test before writing the rest. */
ZTEST(ring_buf_init, test_fresh_state)
{
	zassert_true(rb_is_empty(), "Fresh buffer must be empty");
	zassert_equal(rb_count(), 0, "Fresh buffer count must be 0");
}

ZTEST(ring_buf_init, test_reinit_clears_state)
{
	/* TODO(l8-task1): Push a value, call rb_init(4) again, then
	 * verify the buffer is empty and count is 0.
	 * See TEST_SPEC.md "Suite ring_buf_init" #2.
	 */
	rb_push(99);
	rb_init(4);
	zassert_true(rb_is_empty(), "Buffer must be empty after init");
	zassert_equal(rb_count(), 0, "Buffer count must be 0 after init");
}

/*
 * ============================================================================
 * Test Suite: ring_buf_push_pop
 *
 * Single push/pop round-trip, FIFO order, full error path.
 * ============================================================================
 */
ZTEST_SUITE(ring_buf_push_pop, NULL, NULL, before, NULL, NULL);

ZTEST(ring_buf_push_pop, test_single_push_pop)
{
	/* TODO(l8-task1): rb_push(42), rb_pop(&v) -> v == 42, buffer empty after.
	 * See TEST_SPEC.md "Suite ring_buf_push_pop" #1.
	 */
	int result = 0;
	zassert_ok(rb_push(42), "Push should succeed!");
	zassert_ok(rb_pop(&result), "Pop should succeed!");
	zassert_equal(result, 42, "Result must be 42!");
}

ZTEST(ring_buf_push_pop, test_fifo_order)
{
	/* TODO(l8-task1): rb_push(1), rb_push(2), rb_push(3); pop three times
	 * and verify the values come out as 1, 2, 3 in that order.
	 * See TEST_SPEC.md "Suite ring_buf_push_pop" #2.
	 */
	int result = 0;
	rb_push(1);
	rb_push(2);
	rb_push(3);
	rb_pop(&result);
	zassert_equal(result, 1, "First element must be 1");
	rb_pop(&result);
	zassert_equal(result, 2, "Second element must be 2");
	rb_pop(&result);
	zassert_equal(result, 3, "Third element must be 3");
}

ZTEST(ring_buf_push_pop, test_push_full_returns_enospc)
{
	/* TODO(l8-task1): Fill the buffer to its capacity of 4, then push
	 * one more value -> -ENOSPC.
	 * See TEST_SPEC.md "Suite ring_buf_push_pop" #3.
	 */
	zassert_ok(rb_push(1),"Push should succeed! Not full yet!");
	zassert_ok(rb_push(2),"Push should succeed! Not full yet!");
	zassert_ok(rb_push(3),"Push should succeed! Not full yet!");
	zassert_ok(rb_push(4),"Push should succeed! Not full yet!");
	zassert_equal(rb_push(5),-ENOSPC,"Push should return -ENOSPC! Buffer is full!");
}

/*
 * ============================================================================
 * Test Suite: ring_buf_boundaries
 *
 * Peek semantics and NULL-pointer boundary conditions.
 * ============================================================================
 */
ZTEST_SUITE(ring_buf_boundaries, NULL, NULL, before, NULL, NULL);

ZTEST(ring_buf_boundaries, test_peek_does_not_consume)
{
	/* TODO(l8-task1): rb_push(7); rb_peek(&v) -> v == 7; rb_peek(&v) again
	 * -> v == 7; rb_count() still == 1.
	 * See TEST_SPEC.md "Suite ring_buf_boundaries" #1.
	 */
	int result;
	rb_push(7);
	rb_peek(&result);
	zassert_equal(result,7,"Peek must show the only one value pushed = 7");
	rb_peek(&result);
	zassert_equal(result,7,"Peek again must show the same value pushed = 7");
	zassert_equal(rb_count(),1,"Peek must not consume any value from FIFO");
}

ZTEST(ring_buf_boundaries, test_pop_null_returns_einval)
{
	/* TODO(l8-task1): rb_pop(NULL) -> -EINVAL.
	 * See TEST_SPEC.md "Suite ring_buf_boundaries" #2.
	 */
	zassert_equal(rb_pop(NULL),-EINVAL,"Pop with NULL pointer must return -EINVAL!");
}

ZTEST(ring_buf_boundaries, test_is_full_after_fill)
{
	/* TODO(l8-task1): push 4 values -> rb_is_full() == true, rb_count() == 4.
	 * See TEST_SPEC.md "Suite ring_buf_boundaries" #3.
	 */
	rb_push(1);
	rb_push(2);
	rb_push(3);
	rb_push(4);
	zassert_true(rb_is_full(), "Buffer should be Full!");
	zassert_equal(rb_count(), 4, "Buffer count must be 4!");
}
```
