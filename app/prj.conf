## CMakeLists.txt
```
cmake_minimum_required(VERSION 3.20.0)

list(APPEND BOARD_ROOT ${CMAKE_CURRENT_SOURCE_DIR}/..)
find_package(Zephyr REQUIRED)
project(my_zephyr_app)

target_sources(app PRIVATE src/main.cpp)

# Make application headers accessible
target_include_directories(app PRIVATE
    ${CMAKE_CURRENT_SOURCE_DIR}
)

# Compile custom driver
add_subdirectory(drivers/our_driver)
```

## Kconfig
```
# LED subsystem configuration

config APP_HEARTBEAT_PERIOD_MS
    int "App Heart beat period(ms)"
    default 500
    range 100 2000

menuconfig LED_SUBSYSTEM
    bool "LED Subsystem"
    default y

if LED_SUBSYSTEM

#The options for BLINK_SLEEP_TIME_MS
choice
    prompt "LED blink speed"
    default BLINK_SLEEP_1000MS
config BLINK_SLEEP_250MS
    bool "Fast (250ms)"
config BLINK_SLEEP_1000MS
    bool "Medium (1s)"
config BLINK_SLEEP_2000MS
    bool "Slow (2s)"
endchoice

#Set the value for CONFIG_BLINK_SLEEP_TIME_MS based on choice above
config BLINK_SLEEP_TIME_MS
    int
    default 250  if BLINK_SLEEP_250MS
    default 1000 if BLINK_SLEEP_1000MS
    default 2000 if BLINK_SLEEP_2000MS
    default 0

#For Advanced Led Settings
menuconfig LED_ADVANCED_SETTINGS
    bool "Advanced LED Settings"
    default n

if LED_ADVANCED_SETTINGS

config LED_BRIGHTNESS
    int "LED brightness (0-100)"
    default 100
    range 0 100

config LED_FADE_DURATION
    int "LED fade duration (ms)"
    default 500
    range 0 5000

menu "Expert settings"
    visible if LED_ADVANCED_SETTINGS

config LED_DEBBUG
    bool "Enable LED debbugging"

config LED_CUSTOM_PATTERN
    bool "Custom blink pattern"

endmenu

endif   #LED_ADVANCED_SETTINGS

endif   #LED_SUBSYSTEM 
    
rsource "drivers/our_driver/Kconfig"    
source "Kconfig.zephyr"
```

## prj.conf
```kconfig
CONFIG_GPIO=y
CONFIG_LOG=y
CONFIG_SENSOR=y
CONFIG_OUR_DRIVER=y
CONFIG_SHELL=y
CONFIG_OUR_DRIVER_SHELL=y
```

## app.overlay
```dts
/ {
	aliases{
		app-led = &red_led;		//by node
		app-led-green = &green_led;	//by node
		app-led-blue = "/leds/led_2"; 	//by path - make sure you pick the righ name from "zephyr\boards\nxp\frdm_mcxn236\frdm_mcxn236.dts"
	};
};
```

## dts/bindings/zephyr,our-driver.yaml
```yaml
description: Our Simple GPIO Driver
compatible: "zephyr,our-driver"
include: base.yaml
```

## src/main.cpp
```c
#include <zephyr/drivers/gpio.h>
#include <zephyr/kernel.h>
#include <zephyr/logging/log.h>

//#define SLEEP_TIME_MS 1000

/* The devicetree node identifier for the "led0" alias. */
#define LED_NODE DT_ALIAS(app_led)

static const struct gpio_dt_spec led = GPIO_DT_SPEC_GET(LED_NODE, gpios);

LOG_MODULE_REGISTER(main, LOG_LEVEL_INF);

int main(void)
{
    bool led_state = true;

    if (!gpio_is_ready_dt(&led)) return 0;

    if (gpio_pin_configure_dt(&led, GPIO_OUTPUT_ACTIVE) < 0) return 0;

    while (1) {
        if (gpio_pin_toggle_dt(&led) < 0) return 0;

        led_state = !led_state;
        //printf("LED state: %s\n", led_state ? "ON" : "OFF");
        LOG_INF("LED state: %s", led_state ? "ON" : "OFF");
        k_msleep(CONFIG_APP_HEARTBEAT_PERIOD_MS);
    }
    return 0;
}
```
